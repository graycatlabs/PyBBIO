/dts-v1/;
/plugin/;

/{
  compatible = "ti,beaglebone", "ti,beaglebone-black";
  /* identification */
  part-number = "PyBBIO-AIN6";
  version = "00A0";

  /* state the resources this cape uses */
  exclusive-use =
  /* the pin header uses */
  "P9.35";

  fragment@0 {
    target = <&ocp>;
      __overlay__ {
      /* avoid stupid warning */
      #address-cells = <1>;
      #size-cells = <1>;
      adc_helper: PyBBIO-AIN6 {
        compatible = "bone-iio-helper";
        vsense-name = "AIN6";
        vsense-scale = <100>;
        status = "okay";
      };
    };
  };
};
