/* Enables the BeagleBone's PWM sub system 1
 * 
 * This overlay was created for PyBBIO:
 * github.com/alexanderhiam/PyBBIO
 * 
 * This file is in the Public Domain.
 */

/dts-v1/;
/plugin/;
/{
  compatible = "ti,beaglebone", "ti,beaglebone-black";
  /* identification */
  part-number = "PyBBIO-epwmss1";
  version = "00A0";
  fragment@0 {
    target = <&epwmss1>;
    __overlay__ {
      status = "okay";
    };
  };
};
