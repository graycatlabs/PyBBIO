/* Enables the BeagleBone's ADC
 * 
 * This overlay was created for PyBBIO:
 * github.com/alexanderhiam/PyBBIO
 * 
 * This file is in the Public Domain.
 */

/dts-v1/;
/plugin/;
/{
  compatible = "ti,beaglebone", "ti,beaglebone-black";
  /* identification */
  part-number = "ADC-ENABLE";
  version = "00A0";

  /* state the resources this cape uses */
  exclusive-use =
  /* the hardware IP uses */
  "tscadc";

  fragment@0 {
    target = <&ocp>;
      __overlay__ {
      /* avoid stupid warning */
      #address-cells = <1>;
      #size-cells = <1>;
      tscadc {
        compatible = "ti,ti-tscadc";
        reg = <0x44e0d000 0x1000>;
        interrupt-parent = <&intc>;
        interrupts = <16>;
        ti,hwmods = "adc_tsc";
        status = "okay";
        adc {
          ti,adc-channels = <0 1 2 3 4 5 6 7>;
        };
      };
    };
  };
};